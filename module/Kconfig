## module/Kconfig
```kconfig
menuconfig ZMK_LAYOUT_RESYNC
    bool "Keep the language layer in step with the connected host"
    default y
    depends on ZMK_BLE
    depends on !ZMK_SPLIT || ZMK_SPLIT_ROLE_CENTRAL
    help
      Remembers which language each BLE profile was left on and restores it
      when you come back to that host. It never resets a language: after
      unlocking, both macOS and iPadOS restore whatever was active before
      locking, so resetting would be wrong for the whole session.

      Both dependencies are load bearing. app/CMakeLists.txt builds keymap.c
      and ble.c only for a central or non-split target, so op36_right has
      neither; settings_reset is not split and does build keymap.c, but sets
      CONFIG_ZMK_BLE=n and so has no ble.c. Dropping either dependency breaks
      the link on one of them.

if ZMK_LAYOUT_RESYNC

config ZMK_LAYOUT_RESYNC_ALT_LAYER
    int "Layer holding the alternate language"
    default 1
    help
      The layer that is raised for the second language. On op36_ruen this is
      1, the ru layer. The design assumes exactly two languages.

endif # ZMK_LAYOUT_RESYNC
```
